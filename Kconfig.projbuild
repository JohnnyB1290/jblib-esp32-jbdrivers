## Kconfig.projbuild
```kconfig
menu "ESP32 JBDrivers"
	
	menu "Uart Channel"
	
		config UART_CHANNEL_CONSOLE_ENABLE
			bool "Enable console"
			default y
			
		config UART_CHANNEL_TX_BUFFER_SIZE
			int "UART TX Buffer Size"
			range 256 4096
			default 1024
			help
				Buffer size of UART TX buffer.
		
		config UART_CHANNEL_RX_BUFFER_SIZE
			int "UART RX Buffer Size"
			range 256 4096
			default 2048
			help
				Buffer size of UART RX buffer.
				
		config UART_CHANNEL_RX_FIFO_FULL_TRESHOLD
			int "UART RX FIFO Full treshold"
			range 1 127
			default 120

		config UART_CHANNEL_RX_TIMEOUT_TRESHOLD
			int "UART RX Timeout treshold"
			range 1 255
			default 10
			
		config UART_CHANNEL_TX_FIFO_EMPTY_TRESHOLD
			int "UART TX FIFO Empty treshold"
			range 1 255
			default 10	

		config UART_CHANNEL_EVENT_QUEUE_SIZE
			int "UART Event Queue Size"
			range 16 64
			default 32
			help
				Length of UART event queue.
			
		config UART_CHANNEL_TASK_STACK_SIZE
			int "Task stack size"
			range 2048 32768
			default 2048

		config UART_CHANNEL_TASK_PRIORITY
			int "Task priority"
			range 1 32
			default 1
			
	endmenu  #Uart Modem

	menu "Encoder"

		config ENCODER_FILTER_TASK_STACK_SIZE
			int "Filter Task stack size"
			range 2048 32768
			default 2048

		config ENCODER_FILTER_TASK_PRIORITY
			int "Filter Task priority"
			range 1 32
			default 1

		config ENCODER_FILTER_DELAY_MS
            int "Filter delay, ms"
            range 1 1000
            default 25

	endmenu  #Encoder

endmenu  #ESP32 Modem
```
